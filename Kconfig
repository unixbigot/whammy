## Kconfig
```kconfig
mainmenu "Example"

rsource "ztacx/Kconfig.ztacx"
source "Kconfig.zephyr"

config APP_DAC_DEVICE
       string "Name of device to use for DAC output readings"
       default "dac0"
       depends on ZTACX_LEAF_IMS

config APP_ROLE_TRANSMITTER
       bool "Act as an expression transmitter (pedal)"
       default "true"

config APP_ROLE_RECEIVER
       bool "Act as an expression receiver (virtual pedal)"
       default "false"

config APP_TILT_THRESHOLD
       int "Threshold for tilt change (centidegree)"
       default 500
```

## boards/accelerando_hailstone.conf
```kconfig
# Uncomment these below to use serial console
CONFIG_CONSOLE=y
CONFIG_STDOUT_CONSOLE=y
CONFIG_UART_CONSOLE=y
CONFIG_UART_LINE_CTRL=y
CONFIG_LOG_BACKEND_UART=y
CONFIG_SHELL_BACKEND_SERIAL=y
CONFIG_SHELL_LOG_BACKEND=n

# Uncomment the below to use RTT instead of serial console
#CONFIG_USE_SEGGER_RTT=y
#CONFIG_RTT_CONSOLE=y
#CONFIG_SEGGER_RTT_BUFFER_SIZE_DOWN=256
#CONFIG_SHELL_BACKEND_RTT=y

CONFIG_ZTACX_IMS_DEVICE="accel0"
CONFIG_ZTACX_IMS_CHANGE_THRESHOLD=100
CONFIG_LIS2DH_ACCEL_RANGE_2G=y
CONFIG_LIS2DH_OPER_MODE_HIGH_RES=y
CONFIG_LIS2DH_ODR_3=y

# app settings
CONFIG_APP_ROLE_TRANSMITTER=y
CONFIG_APP_ROLE_RECEIVER=n
```

## boards/accelerando_redsoil.conf
```kconfig
CONFIG_BT_DEVICE_NAME="Whammy Rx"
CONFIG_BT_DIS_MODEL="Whammy Rx"
CONFIG_BT_CENTRAL=y

CONFIG_SPI=n
CONFIG_I2S=y
CONFIG_LED_STRIP=y
CONFIG_LED_STRIP_LOG_LEVEL_DBG=y
CONFIG_WS2812_STRIP=y
CONFIG_WS2812_STRIP_I2S=y

# Uncomment these below to use serial console
CONFIG_CONSOLE=y
CONFIG_STDOUT_CONSOLE=y
CONFIG_UART_CONSOLE=y
CONFIG_UART_LINE_CTRL=y
CONFIG_LOG_BACKEND_UART=y
CONFIG_SHELL_LOG_BACKEND=n
CONFIG_SHELL_BACKEND_SERIAL=y

# Uncomment the below to use RTT instead of serial console
#CONFIG_USE_SEGGER_RTT=y
#CONFIG_RTT_CONSOLE=y
#CONFIG_SEGGER_RTT_BUFFER_SIZE_DOWN=256
#CONFIG_SHELL_BACKEND_RTT=y

# ztacx modules
CONFIG_ZTACX_LEAF_DAC=y
CONFIG_ZTACX_LEAF_IMS=n
CONFIG_ZTACX_LEAF_LED_STRIP=y
CONFIG_ZTACX_LEAF_BT_CENTRAL=y
CONFIG_ZTACX_LEAF_BT_PERIPHERAL=n
CONFIG_ZTACX_BT_CENTRAL_PERIPHERAL_NAME="Whammy Puck"

# app settings
CONFIG_APP_ROLE_TRANSMITTER=n
CONFIG_APP_ROLE_RECEIVER=y
```
